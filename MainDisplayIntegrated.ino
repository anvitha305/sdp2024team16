#include <SPI.h>
#include <Wire.h>
#include <Adafruit_GFX.h>
#include <Adafruit_SSD1306.h>
#include <Adafruit_Sensor.h>
#include <Adafruit_BNO055.h>
#include <utility/imumaths.h>

#define SCREEN_WIDTH 128 // OLED display width, in pixels
#define SCREEN_HEIGHT 64 // OLED display height, in pixels
#define DISPLAY_DIST 155.0
#define DISPLAY_HEIGHT 35.05 
#define DISPLAY_WIDTH 15.32

// Declaration for SSD1306 display connected using software SPI:
#define OLED_DC    0
#define OLED_CS    5
#define OLED_RESET 1
#define OLED_MOSI  3
#define OLED_CLK   2

// Button pins
#define BUTTON_TOP_PIN 9
#define BUTTON_MIDTOP_PIN 16
#define BUTTON_MIDBOT_PIN 14
#define BUTTON_BOTTOM_PIN 15

#define DEBOUNCE_DELAY 100             // ms between accepted button events
#define PUSH_HOLD_DELAY 1000           // ms to hold button before repeating actions
#define PUSH_HOLD_REPEAT 50            // ms between repeated actions when holding button
#define BNO055_SAMPLERATE_DELAY_MS 100 // ms between IMU samples


// Button class for debouncing and push-hold
class Button {
public:
  int PIN;
  unsigned long last_change;
  int state;
  unsigned long last_trigger;

  Button(int pin) {
    this->PIN = pin;
    this->last_change = 0;
    this->state = 0;
    this->last_trigger = 0;
  }

  boolean shouldTrigger(){
    int newState = digitalRead((PIN));
    boolean will_trigger = false;
    int change_diff = millis() - last_change;
    int trigger_diff = millis() - last_trigger;
    if(state == HIGH && newState == LOW && trigger_diff > DEBOUNCE_DELAY){
      will_trigger = true;
    }else if(newState == LOW && state == LOW && change_diff > PUSH_HOLD_DELAY && trigger_diff > PUSH_HOLD_REPEAT){
      will_trigger = true;
    }

    if(newState != state){
      last_change = millis();
      state = newState;
    }
    if(will_trigger){
      last_trigger = millis();
    }
    return will_trigger;
  }
};

class Vec3f {
public:
  float x, y, z;
  Vec3f() : x(0), y(0), z(0) {}


  Vec3f(float x, float y, float z) {
    this->x = x;
    this->y = y;
    this->z = z;
  }

  Vec3f add(Vec3f other) {
    return Vec3f(x + other.x, y + other.y, z + other.z);
  }

  Vec3f subtract(Vec3f other) {
    return Vec3f(x - other.x, y - other.y, z - other.z);
  }

  Vec3f multiply(float scalar) {
    float newX = x * scalar;
    float newY = y * scalar;
    float newZ = z * scalar;

    return Vec3f(newX, newY, newZ);
  }

  Vec3f cross(Vec3f other) {
    float newX = y * other.z - z * other.y;
    float newY = z * other.x - x * other.z;
    float newZ = x * other.y - y * other.x;

    return Vec3f(newX, newY, newZ);
  }

  float dot(Vec3f other) {
    return x * other.x + y * other.y + z * other.z;
  }

  Vec3f normalize() {
    float magnitude = sqrt(x * x + y * y + z * z);

    // Check for division by zero
    if (magnitude == 0) {
      // Handle the error as needed
    }

    float newX = x / magnitude;
    float newY = y / magnitude;
    float newZ = z / magnitude;

    return Vec3f(newX, newY, newZ);
  }

  float length() {
    return sqrt(x * x + y * y + z * z);
  }

  float lengthSquared() {
    return x * x + y * y + z * z;
  }

  Vec3f project(Vec3f other) {
    float dotProduct = this->dot(other);
    float uMagnitudeSquared = other.lengthSquared();

    // Check for division by zero
    if (uMagnitudeSquared == 0) {
      // Handle the error as needed
    }

    float scalar = dotProduct / uMagnitudeSquared;

    return other.multiply(scalar);
  }

  Vec3f applyEWMA(float alpha, Vec3f ewma){
    return Vec3f(x*alpha + (1-alpha)*ewma.x,y*alpha + (1-alpha)*ewma.y,z*alpha + (1-alpha)*ewma.z);
  }

  Vec3f applyCircAvg(Vec3f data2){
    //Serial.print("2- (");
      //Serial.print(data2.x);
     // Serial.print(",");
      //Serial.print(data2.y);
      //Serial.print(",");
     // Serial.print(data2.z);
     // Serial.println();
     // Serial.println(")");

    float diffx = max(x, data2.x) - min(x, data2.x);
    float x_val, y_val,z_val = 0;
    if (diffx > 180){
        x_val = fmod(((min(x, data2.x) + 360 + max(x,data2.x))/2), 360); // adjust x val for the smaller val to be shifted by 360 so that the averaging is a directional/circular average
    }
    
    else{
       x_val = fmod((x + data2.x)/2.0, 360); // ordinary average
    }
    float diffy = y - data2.y;
    if (diffy > 90){
         diffy -= 180; // make sure it's in the range -180, 180 for the averaging
    }
    if (diffy < -90){
         diffy += 180;
    }
    y_val = fmod((y + diffy)/2.0 + 90, 180) - 90;
    //repeat it all for z
    float diffz = z - data2.z;
    if (diffz > 180){
        diffz -= 360; // Adjust to fit in the range -90 to 90 for averaging
    }
    if (diffz < -180){
        diffz += 360; // Adjust to fit in the range -90 to 90 for averaging
    }
    z_val = fmod((z + diffz)/2.0 + 180, 360) - 180;
    return Vec3f(x_val, y_val, z_val);
  }

  String toString() {
    return "(" + String(x) + ", " + String(y) + ", " + String(z) + ")";
  }

  bool operator!=(const Vec3f &other) const {
    return x != other.x || y != other.y || z != other.z;
  }
};

class Quaternion {
public:
  float w, x, y, z;
  Quaternion() : w(1), x(0), y(0), z(0) {}

  Quaternion(float w, float x, float y, float z) {
    this->w = w;
    this->x = x;
    this->y = y;
    this->z = z;
  }

  Quaternion(Vec3f axis, float angleDeg){
    float angle = (angleDeg * 71.0) / 4068.0;
    float axisX = axis.x;
    float axisY = axis.y;
    float axisZ = axis.z;
         
    float hangle = angle / 2.0f;
    float sinAngle = sin(hangle);
    float vLength = sqrt(axisX * axisX + axisY * axisY + axisZ * axisZ);
    this->w = cos(hangle); 
    this->x = axisX / vLength * sinAngle;
    this->y = axisY / vLength * sinAngle;
    this->z = axisZ / vLength * sinAngle;
  }

  Quaternion mul(Quaternion q) {
    float tempW = (this->w * q.x + (this->x * q.w + (this->y * q.z + (-this->z * q.y))));
    float tempX = (this->w * q.y + (-this->x * q.z + (this->y * q.w + (this->z * q.x))));
    float tempY = (this->w * q.z + (this->x * q.y + (-this->y * q.x + (this->z * q.w))));
    float tempZ = (this->w * q.w + (-this->x * q.x + (-this->y * q.y + (-this->z * q.z))));
    return Quaternion(tempW,tempX,tempY,tempZ);
  }

  Vec3f transform(Vec3f vec){
    return transform(vec.x, vec.y, vec.z, vec);
  }
      
  Vec3f transform(float x, float y, float z, Vec3f dest) {
    float xx = this->x * this->x, yy = this->y * this->y, zz = this->z * this->z, ww = this->w * this->w;
    float xy = this->x * this->y, xz = this->x * this->z, yz = this->y * this->z, xw = this->x * this->w;
    float zw = this->z * this->w, yw = this->y * this->w, k = 1 / (xx + yy + zz + ww);
    dest.x = ((xx - yy - zz + ww) * k * x + (2 * (xy - zw) * k * y + ((2 * (xz + yw) * k) * z)));
    dest.y = (2 * (xy + zw) * k * x + ((yy - xx - zz + ww) * k * y + ((2 * (yz - xw) * k) * z)));
    dest.z = (2 * (xz - yw) * k * x + (2 * (yz + xw) * k * y + (((zz - xx - yy + ww) * k) * z)));
    return dest;
  }
};

const unsigned char epd_bitmap_display_map [] PROGMEM = {
  0xff, 0xff, 0xff, 0xff, 0xff, 0xff, 0xff, 0xff, 0xff, 0xff, 0xff, 0xff, 0xff, 0xff, 0xff, 0xff, 
  0x80, 0x00, 0x00, 0x00, 0x00, 0x00, 0x00, 0x00, 0x00, 0x00, 0x00, 0x00, 0x00, 0x00, 0x01, 0x01, 
  0x80, 0x00, 0x00, 0x00, 0x00, 0x00, 0x00, 0x00, 0x00, 0x00, 0x00, 0x00, 0x00, 0x00, 0x01, 0x01, 
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  0xff, 0xff, 0xff, 0xff, 0xff, 0xff, 0xff, 0xff, 0xff, 0xff, 0xff, 0xff, 0xff, 0xff, 0xff, 0xff
};
// 'number_map_0', 5x3px
const unsigned char epd_bitmap_number_map_0 [] PROGMEM = {
  0xf0, 0x88, 0xf8
};
// 'number_map_1', 5x3px
const unsigned char epd_bitmap_number_map_1 [] PROGMEM = {
  0x90, 0xf8, 0x80
};
// 'number_map_2', 5x3px
const unsigned char epd_bitmap_number_map_2 [] PROGMEM = {
  0xe8, 0xa8, 0x98
};
// 'number_map_3', 5x3px
const unsigned char epd_bitmap_number_map_3 [] PROGMEM = {
  0x88, 0xa8, 0xf8
};
// 'number_map_4', 5x3px
const unsigned char epd_bitmap_number_map_4 [] PROGMEM = {
  0x38, 0x20, 0xf8
};
// 'number_map_5', 5x3px
const unsigned char epd_bitmap_number_map_5 [] PROGMEM = {
  0xb8, 0xa8, 0xc8
};
// 'number_map_6', 5x3px
const unsigned char epd_bitmap_number_map_6 [] PROGMEM = {
  0xf8, 0xa8, 0xe8
};
// 'number_map_7', 5x3px
const unsigned char epd_bitmap_number_map_7 [] PROGMEM = {
  0x08, 0x28, 0xf8
};
// 'number_map_8', 5x3px
const unsigned char epd_bitmap_number_map_8 [] PROGMEM = {
  0xf8, 0xa8, 0xf8
};
// 'number_map_9', 5x3px
const unsigned char epd_bitmap_number_map_9 [] PROGMEM = {
  0xb8, 0xa8, 0xf8
};

// 'target_marker', 7x7px
const unsigned char epd_bitmap_target_marker [] PROGMEM = {
  0x10, 0x38, 0x44, 0xd6, 0x44, 0x38, 0x10
};
// 'center_crosshair', 9x9px
const unsigned char epd_bitmap_center_crosshair [] PROGMEM = {
  0x08, 0x00, 0x00, 0x00, 0x08, 0x00, 0x08, 0x00, 0xbe, 0x80, 0x08, 0x00, 0x08, 0x00, 0x00, 0x00, 
  0x08, 0x00
};
// 'left_arrows', 19x9px
const unsigned char epd_bitmap_left_arrows [] PROGMEM = {
  0x00, 0xe0, 0x00, 0x03, 0xf8, 0x00, 0x0f, 0x1e, 0x00, 0x3c, 0x07, 0x80, 0xf0, 0xe1, 0xe0, 0x03, 
  0xf8, 0x00, 0x0f, 0x1e, 0x00, 0x3c, 0x07, 0x80, 0xf0, 0x01, 0xe0
};
// 'right_arrows', 19x9px
const unsigned char epd_bitmap_right_arrows [] PROGMEM = {
  0xf0, 0x01, 0xe0, 0x3c, 0x07, 0x80, 0x0f, 0x1e, 0x00, 0x03, 0xf8, 0x00, 0xf0, 0xe1, 0xe0, 0x3c, 
  0x07, 0x80, 0x0f, 0x1e, 0x00, 0x03, 0xf8, 0x00, 0x00, 0xe0, 0x00
};
// 'up_arrows', 12x9px
const unsigned char epd_bitmap_up_arrows [] PROGMEM = {
  0xc3, 0x00, 0x61, 0x80, 0x30, 0xc0, 0x18, 0x60, 0x0c, 0x30, 0x18, 0x60, 0x30, 0xc0, 0x61, 0x80, 
  0xc3, 0x00
};
// 'down_arrows', 12x9px
const unsigned char epd_bitmap_down_arrows [] PROGMEM = {
  0x0c, 0x30, 0x18, 0x60, 0x30, 0xc0, 0x61, 0x80, 0xc3, 0x00, 0x61, 0x80, 0x30, 0xc0, 0x18, 0x60, 
  0x0c, 0x30
};
// 'roll_indicator_left', 3x11px
const unsigned char epd_bitmap_roll_indicator_left [] PROGMEM = {
  0x20, 0x20, 0x20, 0x20, 0x20, 0x20, 0x20, 0x20, 0x20, 0x60, 0xc0
};
// 'roll_indicator_right', 3x11px
const unsigned char epd_bitmap_roll_indicator_right [] PROGMEM = {
  0xc0, 0x60, 0x20, 0x20, 0x20, 0x20, 0x20, 0x20, 0x20, 0x20, 0x20
};
// 'counterclockwise_arrows', 25x25px
const unsigned char epd_bitmap_counterclockwise_arrows [] PROGMEM = {
  0x00, 0x3e, 0x00, 0x00, 0x03, 0xfe, 0x00, 0x00, 0x07, 0xc0, 0x3f, 0x00, 0x0e, 0x00, 0x3e, 0x00, 
  0x1c, 0x00, 0x3c, 0x00, 0x38, 0x00, 0x3e, 0x00, 0x30, 0x00, 0x37, 0x00, 0x60, 0x00, 0x23, 0x00, 
  0x60, 0x00, 0x03, 0x00, 0x60, 0x00, 0x03, 0x00, 0xc0, 0x00, 0x01, 0x80, 0xc0, 0x00, 0x01, 0x80, 
  0xc0, 0x00, 0x01, 0x80, 0xc0, 0x00, 0x01, 0x80, 0xc0, 0x00, 0x01, 0x80, 0x60, 0x00, 0x03, 0x00, 
  0x60, 0x00, 0x03, 0x00, 0x62, 0x00, 0x03, 0x00, 0x36, 0x00, 0x07, 0x00, 0x3e, 0x00, 0x0e, 0x00, 
  0x1e, 0x00, 0x1c, 0x00, 0x3e, 0x00, 0x38, 0x00, 0x7e, 0x01, 0xf0, 0x00, 0x00, 0x3f, 0xe0, 0x00, 
  0x00, 0x3e, 0x00, 0x00
};
// 'clockwise_arrows', 25x25px
const unsigned char epd_bitmap_clockwise_arrows [] PROGMEM = {
  0x00, 0x3e, 0x00, 0x00, 0x00, 0x3f, 0xe0, 0x00, 0x7e, 0x01, 0xf0, 0x00, 0x3e, 0x00, 0x38, 0x00, 
  0x1e, 0x00, 0x1c, 0x00, 0x3e, 0x00, 0x0e, 0x00, 0x36, 0x00, 0x07, 0x00, 0x62, 0x00, 0x03, 0x00, 
  0x60, 0x00, 0x03, 0x00, 0x60, 0x00, 0x03, 0x00, 0xc0, 0x00, 0x01, 0x80, 0xc0, 0x00, 0x01, 0x80, 
  0xc0, 0x00, 0x01, 0x80, 0xc0, 0x00, 0x01, 0x80, 0xc0, 0x00, 0x01, 0x80, 0x60, 0x00, 0x03, 0x00, 
  0x60, 0x00, 0x03, 0x00, 0x60, 0x00, 0x23, 0x00, 0x30, 0x00, 0x37, 0x00, 0x38, 0x00, 0x3e, 0x00, 
  0x1c, 0x00, 0x3c, 0x00, 0x0e, 0x00, 0x3e, 0x00, 0x07, 0xc0, 0x3f, 0x00, 0x03, 0xfe, 0x00, 0x00, 
  0x00, 0x3e, 0x00, 0x00
};

// 'number_map_big_0', 6x10px
const unsigned char epd_bitmap_number_map_big_0 [] PROGMEM = {
  0x78, 0xfc, 0xcc, 0xcc, 0xcc, 0xcc, 0xcc, 0xcc, 0xfc, 0x78
};
// 'number_map_big_1', 6x10px
const unsigned char epd_bitmap_number_map_big_1 [] PROGMEM = {
  0x30, 0x70, 0xf0, 0x30, 0x30, 0x30, 0x30, 0x30, 0xfc, 0xfc
};
// 'number_map_big_2', 6x10px
const unsigned char epd_bitmap_number_map_big_2 [] PROGMEM = {
  0x78, 0xfc, 0xcc, 0x0c, 0x7c, 0xf8, 0xc0, 0xc0, 0xfc, 0xfc
};
// 'number_map_big_3', 6x10px
const unsigned char epd_bitmap_number_map_big_3 [] PROGMEM = {
  0x78, 0xfc, 0xcc, 0x0c, 0x3c, 0x3c, 0x0c, 0xcc, 0xfc, 0x78
};
// 'number_map_big_4', 6x10px
const unsigned char epd_bitmap_number_map_big_4 [] PROGMEM = {
  0xcc, 0xcc, 0xcc, 0xcc, 0xfc, 0x7c, 0x0c, 0x0c, 0x0c, 0x0c
};
// 'number_map_big_5', 6x10px
const unsigned char epd_bitmap_number_map_big_5 [] PROGMEM = {
  0xfc, 0xfc, 0xc0, 0xc0, 0xf8, 0x7c, 0x0c, 0x0c, 0xfc, 0xf8
};
// 'number_map_big_6', 6x10px
const unsigned char epd_bitmap_number_map_big_6 [] PROGMEM = {
  0x78, 0xfc, 0xcc, 0xc0, 0xf8, 0xfc, 0xcc, 0xcc, 0xfc, 0x78
};
// 'number_map_big_7', 6x10px
const unsigned char epd_bitmap_number_map_big_7 [] PROGMEM = {
  0xfc, 0xfc, 0x0c, 0x0c, 0x1c, 0x18, 0x38, 0x30, 0x70, 0x60
};
// 'number_map_big_8', 6x10px
const unsigned char epd_bitmap_number_map_big_8 [] PROGMEM = {
  0x78, 0xfc, 0xcc, 0xcc, 0x78, 0x78, 0xcc, 0xcc, 0xfc, 0x78
};
// 'number_map_big_9', 6x10px
const unsigned char epd_bitmap_number_map_big_9 [] PROGMEM = {
  0x78, 0xfc, 0xcc, 0xcc, 0xfc, 0x7c, 0x0c, 0xcc, 0xfc, 0x78
};
// 'display_menu', 128x64px
const unsigned char epd_bitmap_display_menu [] PROGMEM = {
  0xff, 0xff, 0xff, 0xff, 0xff, 0xff, 0xff, 0xff, 0xff, 0xff, 0xff, 0xff, 0xff, 0xff, 0xff, 0xff, 
  0x80, 0x00, 0x00, 0x00, 0x00, 0x00, 0x00, 0x00, 0x00, 0x00, 0x00, 0x00, 0x00, 0x00, 0x00, 0x01, 
  0x80, 0x00, 0x00, 0x00, 0x00, 0x00, 0x00, 0x00, 0x00, 0x00, 0x00, 0x00, 0x00, 0x00, 0x00, 0x01, 
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  0xff, 0xff, 0xff, 0xff, 0xff, 0xff, 0xff, 0xff, 0xff, 0xff, 0xff, 0xff, 0xff, 0xff, 0xff, 0xff
};
// 'menu_selector', 124x18px
const unsigned char epd_bitmap_menu_selector [] PROGMEM = {
  0x3f, 0xff, 0xff, 0xff, 0xff, 0xff, 0xff, 0xff, 0xff, 0xff, 0xff, 0xff, 0xff, 0xff, 0xff, 0xc0, 
  0x7f, 0xff, 0xff, 0xff, 0xff, 0xff, 0xff, 0xff, 0xff, 0xff, 0xff, 0xff, 0xff, 0xff, 0xff, 0xe0, 
  0xc0, 0x03, 0x80, 0x00, 0x00, 0x00, 0x00, 0x00, 0x00, 0x00, 0x00, 0x00, 0x00, 0x00, 0x00, 0x70, 
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  0x3f, 0xff, 0xff, 0xff, 0xff, 0xff, 0xff, 0xff, 0xff, 0xff, 0xff, 0xff, 0xff, 0xff, 0xff, 0xc0
};
// 'meters', 40x10px
const unsigned char epd_bitmap_meters [] PROGMEM = {
  0xc6, 0xfb, 0xf7, 0xde, 0x1f, 0xc6, 0xfb, 0xf7, 0xdf, 0x3f, 0xee, 0xc0, 0xc6, 0x1b, 0xb0, 0xfe, 
  0xc0, 0xc6, 0x19, 0xb0, 0xfe, 0xf0, 0xc7, 0x9b, 0xbe, 0xd6, 0xf0, 0xc7, 0x9f, 0x1f, 0xc6, 0xc0, 
  0xc6, 0x1e, 0x03, 0xc6, 0xc0, 0xc6, 0x1b, 0x03, 0xc6, 0xf8, 0xc7, 0xdb, 0xbf, 0xc6, 0xf8, 0xc7, 
  0xd9, 0xbe
};
// 'feet', 24x10px
const unsigned char epd_bitmap_feet [] PROGMEM = {
  0xfb, 0xef, 0xbf, 0xfb, 0xef, 0xbf, 0xc3, 0x0c, 0x0c, 0xc3, 0x0c, 0x0c, 0xf3, 0xcf, 0x0c, 0xf3, 
  0xcf, 0x0c, 0xc3, 0x0c, 0x0c, 0xc3, 0x0c, 0x0c, 0xc3, 0xef, 0x8c, 0xc3, 0xef, 0x8c
};

// Array of all bitmaps for convenience.
const int epd_bitmap_allArray_LEN = 35;
const unsigned char* epd_bitmap_allArray[epd_bitmap_allArray_LEN] = {
  epd_bitmap_number_map_0, // 0
  epd_bitmap_number_map_1, // 1
  epd_bitmap_number_map_2, // 2
  epd_bitmap_number_map_3, // 3
  epd_bitmap_number_map_4, // 4
  epd_bitmap_number_map_5, // 5 
  epd_bitmap_number_map_6, // 6
  epd_bitmap_number_map_7, // 7
  epd_bitmap_number_map_8, // 8
  epd_bitmap_number_map_9, // 9 
  epd_bitmap_display_map, // 10
  epd_bitmap_target_marker, // 11
  epd_bitmap_center_crosshair, // 12
  epd_bitmap_left_arrows, // 13
  epd_bitmap_right_arrows, // 14
  epd_bitmap_up_arrows, // 15
  epd_bitmap_down_arrows, // 16
  epd_bitmap_roll_indicator_left, // 17
  epd_bitmap_roll_indicator_right, // 18
  epd_bitmap_counterclockwise_arrows, // 19
  epd_bitmap_clockwise_arrows, // 20
  epd_bitmap_number_map_big_0, // 21
  epd_bitmap_number_map_big_1, // 22
  epd_bitmap_number_map_big_2, // 23
  epd_bitmap_number_map_big_3, // 24
  epd_bitmap_number_map_big_4, // 25
  epd_bitmap_number_map_big_5, // 26
  epd_bitmap_number_map_big_6, // 27
  epd_bitmap_number_map_big_7, // 28
  epd_bitmap_number_map_big_8, // 29
  epd_bitmap_number_map_big_9, // 30
  epd_bitmap_display_menu, // 31
  epd_bitmap_menu_selector, // 32
  epd_bitmap_meters, // 33
  epd_bitmap_feet // 34
};

// Global Variables
Adafruit_SSD1306 display(SCREEN_WIDTH, SCREEN_HEIGHT, OLED_MOSI, OLED_CLK, OLED_DC, OLED_RESET, OLED_CS); // initialize display class
Adafruit_BNO055 bno = Adafruit_BNO055(55,0x28, &Wire);                                                    // initialize IMU 1 class
Adafruit_BNO055 bno2 = Adafruit_BNO055(56,0x29, &Wire);                                                   // initialize IMU 2 class
int mode = 1; // 0 - menu, 1 - target
Button top_button(BUTTON_TOP_PIN);
Button bottom_button(BUTTON_BOTTOM_PIN);
Button midtop_button(BUTTON_MIDTOP_PIN);
Button midbot_button(BUTTON_MIDBOT_PIN);
float alpha = 0.5; // ewma coefficient
unsigned long last_sensor_check;
Vec3f sensor_avg_1, sensor_avg_2, sensor_mean = {0,0,0};
Vec3f sensor_data = {0,0,0};
Vec3f grav_vec = {-9.8,0,0};

// Menu Variables
int selected_param = 0; // 0 - distance, 1 - speed, 2 - units
int raw_distance = 18;
int raw_speed = 75; // units / second
int units = 0; // 0 - meters, 1 - feet

// Target Variables
int battery = 99;
int target_x = 64;
int target_y = 32;
Vec3f target_point = {0,0,0};

// Alignment Offsets
float pitch_offset = 0;
float yaw_offset = 0;
float roll_offset = 90;

void setup() {
  Wire.setSDA(20);
  Wire.setSCL(21);
  Wire.begin();

  Serial.begin(115200); // set communication speed for the serial monitor
  while (!Serial) delay(10);  // wait for serial port to open!

  Serial.println(F("Booting"));

  if(!display.begin(SSD1306_SWITCHCAPVCC)) {
    Serial.println(F("SSD1306 allocation failed"));
    for(;;); // Don't proceed, loop forever
  }

  if (!bno.begin() || !bno2.begin()){
    Serial.print("Oops, both BNO055s haven't been detected. ... Check your wiring or I2C ADDR!");
    while (1);
  }  

  Serial.println(F("Peripherals Loaded"));

  pinMode(BUTTON_TOP_PIN, INPUT_PULLUP);
  pinMode(BUTTON_BOTTOM_PIN, INPUT_PULLUP);
  pinMode(BUTTON_MIDTOP_PIN, INPUT_PULLUP);
  pinMode(BUTTON_MIDBOT_PIN, INPUT_PULLUP);

  // Clear the buffer.
  display.clearDisplay();
}

void loop() {
  // put your main code here, to run repeatedly:

  read_buttons();

  if(mode == 0){
    render_menu();
  }else{
    if (millis()-last_sensor_check > BNO055_SAMPLERATE_DELAY_MS){    
      display.clearDisplay();           
      sensor_data = read_sensors();   
      Serial.println(grav_vec.toString());
/*
      Serial.print("1- (");
      Serial.print(sensor_data.x);
      Serial.print(",");
      Serial.print(sensor_data.y);
      Serial.print(",");
      Serial.print(sensor_data.z);
      Serial.println(")");
*/
      render_target();
    }
  }
}

void render_menu(){
  display.clearDisplay();

  int range_1 = (int) raw_distance / 100;
  int range_2 = (int) (raw_distance/10) % 10;
  int range_3 = (int) raw_distance % 10;

  int speed_1 = (int) raw_speed / 100;
  int speed_2 = (int) (raw_speed/10) % 10;
  int speed_3 = (int) raw_speed % 10;

  // Main Background
  display.drawBitmap(0, 0, epd_bitmap_allArray[31], 128, 64, 1); 

  // Selector Bar
  display.drawBitmap(2, 2+selected_param*21, epd_bitmap_allArray[32], 124, 18, 1); 

  // Range Readout
  display.drawBitmap(102, 6, epd_bitmap_allArray[21+range_1], 6, 10, 1); 
  display.drawBitmap(109, 6, epd_bitmap_allArray[21+range_2], 6, 10, 1); 
  display.drawBitmap(116, 6, epd_bitmap_allArray[21+range_3], 6, 10, 1); 

  // Speed Readout
  display.drawBitmap(98, 26, epd_bitmap_allArray[21+speed_1], 6, 10, 1); 
  display.drawBitmap(105, 26, epd_bitmap_allArray[21+speed_2], 6, 10, 1); 
  display.drawBitmap(112, 26, epd_bitmap_allArray[21+speed_3], 6, 10, 1); 

  // Units Display
  if(units == 0){
    display.drawBitmap(59, 48, epd_bitmap_allArray[33], 40, 10, 1); 
  }else{
    display.drawBitmap(59, 48, epd_bitmap_allArray[34], 24, 10, 1); 
  }
  // Load to the display
  display.display();
}
Vec3f read_sensors(){
  last_sensor_check = millis();
  uint8_t sys, gyro, accel, mag = 0;
  uint8_t sys2, gyro2, accel2, mag2 = 0;
  Vec3f s0_1, s0_2 = {0,0,0};
  uint32_t address = 0;
  bno.getCalibration(&sys, &gyro, &accel, &mag);
  bno2.getCalibration(&sys2, &gyro2, &accel2, &mag2);

  sensors_event_t event, event2;
  bno.getEvent(&event);
  bno2.getEvent(&event2);
  
  // using orientation for this example and can do the same for multiple sensors
  s0_1 = {360 - (float)event.orientation.x, (float)(event.orientation.y), (float)event.orientation.z};
  s0_2 = {360 - (float)event2.orientation.x, (float)(event2.orientation.y), (float)event2.orientation.z};
  sensor_avg_1 = s0_1.applyCircAvg(sensor_avg_1);
  sensor_avg_2 = s0_2.applyCircAvg(sensor_avg_2);
  sensor_mean = sensor_avg_1.applyCircAvg(sensor_avg_2);

  // showing writing to the max address and loopback for a partition of the EEPROM:
  if(address < 100*2*sizeof(uint8_t)){
  // Serial.print(F("Calibration Sensor 1: "));
  // Serial.print(sys, DEC);
  // Serial.println(F(""));
  // Serial.print(F("Calibration Sensor 2: "));
  // Serial.print(sys2, DEC);
  // Serial.println(F(""));
  byte calibrations[2] = {sys, sys2};                                // create variable to hold the data value sent
  address += sizeof(calibrations); 
  }
  else {
    address = 0;
  }
  sensors_event_t event3;
  bno.getEvent(&event3,Adafruit_BNO055::VECTOR_GRAVITY);
  
  // update gravity vec for the calculation of gravitational component
  grav_vec = {(float)event3.acceleration.x, (float)event3.acceleration.y, (float)event3.acceleration.z};
  // map the values observed for y and z to their actual range of angles.
  return Vec3f(sensor_mean.x,-1*mapRange(sensor_mean.y, -30, 30, -90, 90),mapRange(sensor_mean.z,-60, 0, -180, 180));
}

void read_buttons(){
  if(bottom_button.shouldTrigger()){
    mode = (mode+1) % 2;
  }
  if(mode == 0){
    if(midbot_button.shouldTrigger()){
      if(selected_param == 0 && raw_distance > 1){
        raw_distance--;
      }else if(selected_param == 1 && raw_speed > 1){
        raw_speed--;
      }else if(selected_param == 2){
        units = (units+1) % 2;
      }
    }
    if(midtop_button.shouldTrigger()){
      if(selected_param == 0 && raw_distance < 998){
        raw_distance++;
      }else if(selected_param == 1 && raw_speed < 998){
        raw_speed++;
      }else if(selected_param == 2){
        units = (units+1) % 2;
      }
    }
    if(top_button.shouldTrigger()){
      selected_param = (selected_param+1) % 3;
    }
  }else if(mode == 1){
    if(midbot_button.shouldTrigger()){
      float pitch = 0;
      float yaw = 0;
      float f = (pitch * 71.0) / 4068.0;
      float g = (-yaw * 71.0) / 4068.0;
      float h = cos(g);
      float i = sin(g);
      float j = cos(f);
      float k = sin(f);

      Vec3f cameraVec3f = Vec3f(i * j, -k, h * j);
      float dist_mm = raw_distance * 1000;
      if(units == 1){
        dist_mm *= 0.3048;
      }

      target_point = cameraVec3f.multiply(dist_mm);
    }
    if(top_button.shouldTrigger()){
      yaw_offset = sensor_data.x;
      pitch_offset = sensor_data.y;
    }
    if(midtop_button.shouldTrigger()){
      
    }
  }
}

void render_target(){
  float roll = sensor_data.z - roll_offset;
  float pitch = -(sensor_data.y - pitch_offset);
  float yaw = sensor_data.x - yaw_offset;
  if(yaw < 0){
    yaw += 360;
  }

  float abs_pitch = abs(pitch);
  int pitch_1 = (int) abs_pitch / 10;
  int pitch_2 = (int) abs_pitch % 10;
  int pitch_3 = (int) (abs_pitch*10) % 10;
  int pitch_4 = (int) (abs_pitch*100) % 10;

  int yaw_1 = (int) yaw / 100;
  int yaw_2 = (int) (yaw/10) % 10;
  int yaw_3 = (int) yaw % 10;
  int yaw_4 = (int) (yaw*10) % 10;
  int yaw_5 = (int) (yaw*100) % 10;

  int battery_1 = battery / 10;
  int battery_2 = battery % 10;

  float adjusted_yaw = yaw;
  if(yaw > 180){
    adjusted_yaw = yaw-360;
  }
  target_x = (int)(adjusted_yaw * (45.0/180.0) + 60);
  target_y = (int)(pitch * (30.0/180.0) + 62);

  boolean left_arrows = target_y < 3;
  boolean right_arrows = target_y > 66;
  boolean up_arrows = target_x > 130;
  boolean down_arrows = target_x < 3;

  int crosshair_x = 59;
  int crosshair_y = 28;

  // Main Background
  display.drawBitmap(0, 0, epd_bitmap_allArray[10], 128, 64, 1);

  // Pitch Indicator
  if(pitch_1 >= 0 && pitch_1 <= 9){
    display.drawBitmap(113, 26, epd_bitmap_allArray[pitch_1], 5, 3, 1);
  }

  if(pitch_2 >= 0 && pitch_2 <= 9){
    display.drawBitmap(113, 30, epd_bitmap_allArray[pitch_2], 5, 3, 1);
  }
  if(pitch_3 >= 0 && pitch_3 <= 9){
    display.drawBitmap(113, 36, epd_bitmap_allArray[pitch_3], 5, 3, 1);
  }
  if(pitch_4 >= 0 && pitch_4 <= 9){
    display.drawBitmap(113, 40, epd_bitmap_allArray[pitch_4], 5, 3, 1);
  }
  
  // Pitch Sign
  if(pitch > 0){
    display.drawPixel(114,23,1);
    display.drawPixel(116,23,1);
  }
  // Yaw Indicator
  display.drawBitmap(2, 22, epd_bitmap_allArray[yaw_1], 5, 3, 1);
  display.drawBitmap(2, 26, epd_bitmap_allArray[yaw_2], 5, 3, 1);
  display.drawBitmap(2, 30, epd_bitmap_allArray[yaw_3], 5, 3, 1);
  display.drawBitmap(2, 36, epd_bitmap_allArray[yaw_4], 5, 3, 1);
  display.drawBitmap(2, 40, epd_bitmap_allArray[yaw_5], 5, 3, 1);
  // Roll Indicator
  if(roll < -25){
    display.drawBitmap(51, 20, epd_bitmap_allArray[20], 25, 25, 1);
  }else if(roll > 25){
    display.drawBitmap(51, 20, epd_bitmap_allArray[19], 25, 25, 1);
  }else{
    int offset = (int) roll;
    display.drawBitmap(61-offset, 42, epd_bitmap_allArray[18], 3, 11, 1);
    display.drawBitmap(61+offset, 12, epd_bitmap_allArray[17], 3, 11, 1);
  }

  // Battery Percentage
  display.drawBitmap(121, 37, epd_bitmap_allArray[battery_1], 5, 3, 1);
  display.drawBitmap(121, 41, epd_bitmap_allArray[battery_2], 5, 3, 1);
  // Battery Fill
  for(int i = 0; i < battery_1; i++){
    display.drawPixel(122,59-i,1);
    display.drawPixel(123,59-i,1);
    display.drawPixel(124,59-i,1);
  }

  // Arrows
  if(down_arrows){  
    display.drawBitmap(3, 3, epd_bitmap_allArray[16], 12, 9, 1);
    display.drawBitmap(3, 52, epd_bitmap_allArray[16], 12, 9, 1);
  }
  if(up_arrows){  
    display.drawBitmap(105, 3, epd_bitmap_allArray[15], 12, 9, 1);
    display.drawBitmap(105, 52, epd_bitmap_allArray[15], 12, 9, 1);
  }
  if(left_arrows){  
    display.drawBitmap(54, 3, epd_bitmap_allArray[13], 19, 9, 1);
  }
  if(right_arrows){
    display.drawBitmap(54, 52, epd_bitmap_allArray[14], 19, 9, 1);
  }

  // Crosshair
  display.drawBitmap(crosshair_x,crosshair_y, epd_bitmap_allArray[12], 9, 9, 1);

  // Target Marker
  if(target_x > 3 && target_x < 130 && target_y > 3 && target_y < 66){
    display.drawBitmap(target_x-3,target_y-3, epd_bitmap_allArray[11], 7, 7, 1);
  }

  // Load to the display
  display.display();
  
  battery--;
  if(battery < 0){
    battery = 99;
  }
}

Vec3f findIntersection(Vec3f point, Vec3f screen1, Vec3f screen2, Vec3f screen3, Vec3f origin) {
  Vec3f planeNormal = screen2.subtract(screen1).cross(screen3.subtract(screen1)).normalize();
  Vec3f lineDirection = point.subtract(origin).normalize();

  float dotProduct = planeNormal.dot(lineDirection);

  if (abs(dotProduct) < 1e-6) {
    // The line is parallel to the plane, no intersection
    //Serial.println("Parallel!");
    return Vec3f(0xCAFE, 0xCAFE, 0xCAFE);
  }

  float t = (planeNormal.dot(screen1) - planeNormal.dot(origin)) / dotProduct;

  if (t < 0 || t / point.length() > 1) {
    // The intersection point is outside the line segment
    //Serial.println("Out of Line Bounds " + String(t) + " | " + String(t / point.length()));
    return Vec3f(0xCAFE, 0xCAFE, 0xCAFE);
  }

  Vec3f intersectionPoint = origin.add(lineDirection.multiply(t));

  Vec3f uvVec = intersectionPoint.subtract(screen2);
  Vec3f uAxis = screen3.subtract(screen2);
  Vec3f vAxis = screen1.subtract(screen2);
  Vec3f uVec = uvVec.project(uAxis);
  Vec3f vVec = uvVec.project(vAxis);

  float u = uVec.length() / uAxis.length();
  float v = vVec.length() / vAxis.length();

  //Serial.println(String(u) + " | " + String(v) + " | " + uVec.toString() + " | " + vVec.toString());

  if (!(u <= 1 && v <= 1 && uVec.dot(uAxis) >= 0 && vVec.dot(vAxis) >= 0)) {
    //Serial.println("Out of Screen Bounds " + intersectionPoint.toString());
    return Vec3f(0xCAFE, 0xCAFE, 0xCAFE);
  }

  return intersectionPoint;
}

Vec3f findPixel(Vec3f intersectionPoint, Vec3f screen1, Vec3f screen2, Vec3f screen3) {
  Vec3f uvVec = intersectionPoint.subtract(screen2);
  Vec3f uAxis = screen3.subtract(screen2);
  Vec3f vAxis = screen1.subtract(screen2);
  Vec3f uVec = uvVec.project(uAxis);
  Vec3f vVec = uvVec.project(vAxis);

  float u = uVec.length() / uAxis.length();
  float v = vVec.length() / vAxis.length();

  int xPixel = (int)(u * SCREEN_WIDTH);
  int yPixel = (int)(v * SCREEN_HEIGHT);
  return Vec3f(xPixel, yPixel, 0);
}


Vec3f calculateDisplayPixel(float pitch, float yaw, float roll){
	float f = (pitch * 71.0) / 4068.0;
  float g = (-yaw * 71.0) / 4068.0;
  float h = cos(g);
  float i = sin(g);
  float j = cos(f);
  float k = sin(f);

	Vec3f cameraVec3f = Vec3f(i * j, -k, h * j);
  Vec3f origin = Vec3f(0,0,0);
         
  // screen 2 is the bottom left corner, screen 1 is upper left, screen 3 is bottom right
  Vec3f screen1 = Vec3f(DISPLAY_DIST,DISPLAY_HEIGHT/2,-DISPLAY_WIDTH/2);
  Vec3f screen2 = Vec3f(DISPLAY_DIST,-DISPLAY_HEIGHT/2,-DISPLAY_WIDTH/2);
  Vec3f screen3 = Vec3f(DISPLAY_DIST,-DISPLAY_HEIGHT/2,DISPLAY_WIDTH/2);
  Vec3f screen4 = Vec3f(DISPLAY_DIST,DISPLAY_HEIGHT/2,DISPLAY_WIDTH/2);
  Vec3f centerVec = Vec3f(DISPLAY_DIST,0,0);
        
  Quaternion rotQuat1 = Quaternion(Vec3f(0,1,0),-yaw-90);
  float sideAxisAngle = (-(yaw+90) * 71.0) / 4068.0;
  Vec3f sideAxis = Vec3f(sin(sideAxisAngle), 0, cos(sideAxisAngle));
  Quaternion rotQuat2 = Quaternion(sideAxis,-pitch);
  Quaternion rotQuat3 = Quaternion(cameraVec3f,roll);
  Quaternion rotQuat = rotQuat3.mul(rotQuat2.mul(rotQuat1));
        
         
  Vec3f screen1Rot = rotQuat.transform(screen1);
  Vec3f screen2Rot = rotQuat.transform(screen2);
  Vec3f screen3Rot = rotQuat.transform(screen3);
  Vec3f screen4Rot = rotQuat.transform(screen4);
  Vec3f centerVecRot = rotQuat.transform(centerVec);
         
  Vec3f intersectionPoint = findIntersection(target_point, screen1Rot.add(origin), screen2Rot.add(origin), screen3Rot.add(origin),origin);

	if(intersectionPoint.x != 0xCAFE){
    Vec3f pixel = findPixel(intersectionPoint,screen1Rot.add(origin), screen2Rot.add(origin), screen3Rot.add(origin));
    return pixel;
  }
	return Vec3f(-1,-1,-1);
}

// linear formula for turning a range [min_old, max_old] into [min_new, max new]
double mapRange(double value, double min_old, double max_old, double min_new, double max_new) {
    return ((value - min_old) / (max_old - min_old)) * (max_new - min_new) + min_new;
}

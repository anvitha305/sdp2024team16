//#include <MUIU8g2.h>
//#include <U8g2lib.h>
//#include <U8x8lib.h>

#include <SPI.h>
#include <Wire.h>
#include <Adafruit_GFX.h>
#include <Adafruit_SSD1306.h>

#define SCREEN_WIDTH 128 // OLED display width, in pixels
#define SCREEN_HEIGHT 64 // OLED display height, in pixels

// Declaration for SSD1306 display connected using I2C
#define OLED_RESET     -1 // Reset pin # (or -1 if sharing Arduino reset pin)
#define SCREEN_I2C_ADDR 0x3C
//Adafruit_SSD1306 display(SCREEN_WIDTH, SCREEN_HEIGHT, &Wire, OLED_RESET);

// Declaration for SSD1306 display connected using software SPI:
#define OLED_MOSI   9
#define OLED_CLK   10
#define OLED_DC    11
#define OLED_CS    12
#define OLED_RESET 13

Adafruit_SSD1306 display(SCREEN_WIDTH, SCREEN_HEIGHT, OLED_MOSI, OLED_CLK, OLED_DC, OLED_RESET, OLED_CS);

#define BUTTON_RED_PIN 5
#define BUTTON_YELLOW_PIN 4
#define BUTTON_BLUE_PIN 3
#define BUTTON_GREEN_PIN 2

#define DEBOUNCE_DELAY 100
#define PUSH_HOLD_DELAY 1000
#define PUSH_HOLD_REPEAT 50

class Button {
public:
  int PIN;
  unsigned long last_change;
  int state;
  unsigned long last_trigger;

  Button(int pin) {
    this->PIN = pin;
    this->last_change = 0;
    this->state = 0;
    this->last_trigger = 0;
  }

  boolean shouldTrigger(){
    int newState = digitalRead((PIN));
    boolean will_trigger = false;
    int change_diff = millis() - last_change;
    int trigger_diff = millis() - last_trigger;
    if(state == HIGH && newState == LOW && trigger_diff > DEBOUNCE_DELAY){
      will_trigger = true;
    }else if(newState == LOW && state == LOW && change_diff > PUSH_HOLD_DELAY && trigger_diff > PUSH_HOLD_REPEAT){
      will_trigger = true;
    }

    if(newState != state){
      last_change = millis();
      state = newState;
    }
    if(will_trigger){
      last_trigger = millis();
    }
    return will_trigger;
  }
};

const unsigned char epd_bitmap_display_map [] PROGMEM = {
  0xff, 0xff, 0xff, 0xff, 0xff, 0xff, 0xff, 0xff, 0xff, 0xff, 0xff, 0xff, 0xff, 0xff, 0xff, 0xff, 
  0x80, 0x00, 0x00, 0x00, 0x00, 0x00, 0x00, 0x00, 0x00, 0x00, 0x00, 0x00, 0x00, 0x00, 0x01, 0x01, 
  0x80, 0x00, 0x00, 0x00, 0x00, 0x00, 0x00, 0x00, 0x00, 0x00, 0x00, 0x00, 0x00, 0x00, 0x01, 0x01, 
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  0xff, 0xff, 0xff, 0xff, 0xff, 0xff, 0xff, 0xff, 0xff, 0xff, 0xff, 0xff, 0xff, 0xff, 0xff, 0xff
};
// 'number_map_0', 5x3px
const unsigned char epd_bitmap_number_map_0 [] PROGMEM = {
  0xf0, 0x88, 0xf8
};
// 'number_map_1', 5x3px
const unsigned char epd_bitmap_number_map_1 [] PROGMEM = {
  0x90, 0xf8, 0x80
};
// 'number_map_2', 5x3px
const unsigned char epd_bitmap_number_map_2 [] PROGMEM = {
  0xe8, 0xa8, 0x98
};
// 'number_map_3', 5x3px
const unsigned char epd_bitmap_number_map_3 [] PROGMEM = {
  0x88, 0xa8, 0xf8
};
// 'number_map_4', 5x3px
const unsigned char epd_bitmap_number_map_4 [] PROGMEM = {
  0x38, 0x20, 0xf8
};
// 'number_map_5', 5x3px
const unsigned char epd_bitmap_number_map_5 [] PROGMEM = {
  0xb8, 0xa8, 0xc8
};
// 'number_map_6', 5x3px
const unsigned char epd_bitmap_number_map_6 [] PROGMEM = {
  0xf8, 0xa8, 0xe8
};
// 'number_map_7', 5x3px
const unsigned char epd_bitmap_number_map_7 [] PROGMEM = {
  0x08, 0x28, 0xf8
};
// 'number_map_8', 5x3px
const unsigned char epd_bitmap_number_map_8 [] PROGMEM = {
  0xf8, 0xa8, 0xf8
};
// 'number_map_9', 5x3px
const unsigned char epd_bitmap_number_map_9 [] PROGMEM = {
  0xb8, 0xa8, 0xf8
};

// 'target_marker', 7x7px
const unsigned char epd_bitmap_target_marker [] PROGMEM = {
  0x10, 0x38, 0x44, 0xd6, 0x44, 0x38, 0x10
};
// 'center_crosshair', 9x9px
const unsigned char epd_bitmap_center_crosshair [] PROGMEM = {
  0x08, 0x00, 0x00, 0x00, 0x08, 0x00, 0x08, 0x00, 0xbe, 0x80, 0x08, 0x00, 0x08, 0x00, 0x00, 0x00, 
  0x08, 0x00
};
// 'left_arrows', 19x9px
const unsigned char epd_bitmap_left_arrows [] PROGMEM = {
  0x00, 0xe0, 0x00, 0x03, 0xf8, 0x00, 0x0f, 0x1e, 0x00, 0x3c, 0x07, 0x80, 0xf0, 0xe1, 0xe0, 0x03, 
  0xf8, 0x00, 0x0f, 0x1e, 0x00, 0x3c, 0x07, 0x80, 0xf0, 0x01, 0xe0
};
// 'right_arrows', 19x9px
const unsigned char epd_bitmap_right_arrows [] PROGMEM = {
  0xf0, 0x01, 0xe0, 0x3c, 0x07, 0x80, 0x0f, 0x1e, 0x00, 0x03, 0xf8, 0x00, 0xf0, 0xe1, 0xe0, 0x3c, 
  0x07, 0x80, 0x0f, 0x1e, 0x00, 0x03, 0xf8, 0x00, 0x00, 0xe0, 0x00
};
// 'up_arrows', 12x9px
const unsigned char epd_bitmap_up_arrows [] PROGMEM = {
  0xc3, 0x00, 0x61, 0x80, 0x30, 0xc0, 0x18, 0x60, 0x0c, 0x30, 0x18, 0x60, 0x30, 0xc0, 0x61, 0x80, 
  0xc3, 0x00
};
// 'down_arrows', 12x9px
const unsigned char epd_bitmap_down_arrows [] PROGMEM = {
  0x0c, 0x30, 0x18, 0x60, 0x30, 0xc0, 0x61, 0x80, 0xc3, 0x00, 0x61, 0x80, 0x30, 0xc0, 0x18, 0x60, 
  0x0c, 0x30
};
// 'roll_indicator_left', 3x11px
const unsigned char epd_bitmap_roll_indicator_left [] PROGMEM = {
  0x20, 0x20, 0x20, 0x20, 0x20, 0x20, 0x20, 0x20, 0x20, 0x60, 0xc0
};
// 'roll_indicator_right', 3x11px
const unsigned char epd_bitmap_roll_indicator_right [] PROGMEM = {
  0xc0, 0x60, 0x20, 0x20, 0x20, 0x20, 0x20, 0x20, 0x20, 0x20, 0x20
};
// 'counterclockwise_arrows', 25x25px
const unsigned char epd_bitmap_counterclockwise_arrows [] PROGMEM = {
  0x00, 0x3e, 0x00, 0x00, 0x03, 0xfe, 0x00, 0x00, 0x07, 0xc0, 0x3f, 0x00, 0x0e, 0x00, 0x3e, 0x00, 
  0x1c, 0x00, 0x3c, 0x00, 0x38, 0x00, 0x3e, 0x00, 0x30, 0x00, 0x37, 0x00, 0x60, 0x00, 0x23, 0x00, 
  0x60, 0x00, 0x03, 0x00, 0x60, 0x00, 0x03, 0x00, 0xc0, 0x00, 0x01, 0x80, 0xc0, 0x00, 0x01, 0x80, 
  0xc0, 0x00, 0x01, 0x80, 0xc0, 0x00, 0x01, 0x80, 0xc0, 0x00, 0x01, 0x80, 0x60, 0x00, 0x03, 0x00, 
  0x60, 0x00, 0x03, 0x00, 0x62, 0x00, 0x03, 0x00, 0x36, 0x00, 0x07, 0x00, 0x3e, 0x00, 0x0e, 0x00, 
  0x1e, 0x00, 0x1c, 0x00, 0x3e, 0x00, 0x38, 0x00, 0x7e, 0x01, 0xf0, 0x00, 0x00, 0x3f, 0xe0, 0x00, 
  0x00, 0x3e, 0x00, 0x00
};
// 'clockwise_arrows', 25x25px
const unsigned char epd_bitmap_clockwise_arrows [] PROGMEM = {
  0x00, 0x3e, 0x00, 0x00, 0x00, 0x3f, 0xe0, 0x00, 0x7e, 0x01, 0xf0, 0x00, 0x3e, 0x00, 0x38, 0x00, 
  0x1e, 0x00, 0x1c, 0x00, 0x3e, 0x00, 0x0e, 0x00, 0x36, 0x00, 0x07, 0x00, 0x62, 0x00, 0x03, 0x00, 
  0x60, 0x00, 0x03, 0x00, 0x60, 0x00, 0x03, 0x00, 0xc0, 0x00, 0x01, 0x80, 0xc0, 0x00, 0x01, 0x80, 
  0xc0, 0x00, 0x01, 0x80, 0xc0, 0x00, 0x01, 0x80, 0xc0, 0x00, 0x01, 0x80, 0x60, 0x00, 0x03, 0x00, 
  0x60, 0x00, 0x03, 0x00, 0x60, 0x00, 0x23, 0x00, 0x30, 0x00, 0x37, 0x00, 0x38, 0x00, 0x3e, 0x00, 
  0x1c, 0x00, 0x3c, 0x00, 0x0e, 0x00, 0x3e, 0x00, 0x07, 0xc0, 0x3f, 0x00, 0x03, 0xfe, 0x00, 0x00, 
  0x00, 0x3e, 0x00, 0x00
};

// 'number_map_big_0', 6x10px
const unsigned char epd_bitmap_number_map_big_0 [] PROGMEM = {
  0x78, 0xfc, 0xcc, 0xcc, 0xcc, 0xcc, 0xcc, 0xcc, 0xfc, 0x78
};
// 'number_map_big_1', 6x10px
const unsigned char epd_bitmap_number_map_big_1 [] PROGMEM = {
  0x30, 0x70, 0xf0, 0x30, 0x30, 0x30, 0x30, 0x30, 0xfc, 0xfc
};
// 'number_map_big_2', 6x10px
const unsigned char epd_bitmap_number_map_big_2 [] PROGMEM = {
  0x78, 0xfc, 0xcc, 0x0c, 0x7c, 0xf8, 0xc0, 0xc0, 0xfc, 0xfc
};
// 'number_map_big_3', 6x10px
const unsigned char epd_bitmap_number_map_big_3 [] PROGMEM = {
  0x78, 0xfc, 0xcc, 0x0c, 0x3c, 0x3c, 0x0c, 0xcc, 0xfc, 0x78
};
// 'number_map_big_4', 6x10px
const unsigned char epd_bitmap_number_map_big_4 [] PROGMEM = {
  0xcc, 0xcc, 0xcc, 0xcc, 0xfc, 0x7c, 0x0c, 0x0c, 0x0c, 0x0c
};
// 'number_map_big_5', 6x10px
const unsigned char epd_bitmap_number_map_big_5 [] PROGMEM = {
  0xfc, 0xfc, 0xc0, 0xc0, 0xf8, 0x7c, 0x0c, 0x0c, 0xfc, 0xf8
};
// 'number_map_big_6', 6x10px
const unsigned char epd_bitmap_number_map_big_6 [] PROGMEM = {
  0x78, 0xfc, 0xcc, 0xc0, 0xf8, 0xfc, 0xcc, 0xcc, 0xfc, 0x78
};
// 'number_map_big_7', 6x10px
const unsigned char epd_bitmap_number_map_big_7 [] PROGMEM = {
  0xfc, 0xfc, 0x0c, 0x0c, 0x1c, 0x18, 0x38, 0x30, 0x70, 0x60
};
// 'number_map_big_8', 6x10px
const unsigned char epd_bitmap_number_map_big_8 [] PROGMEM = {
  0x78, 0xfc, 0xcc, 0xcc, 0x78, 0x78, 0xcc, 0xcc, 0xfc, 0x78
};
// 'number_map_big_9', 6x10px
const unsigned char epd_bitmap_number_map_big_9 [] PROGMEM = {
  0x78, 0xfc, 0xcc, 0xcc, 0xfc, 0x7c, 0x0c, 0xcc, 0xfc, 0x78
};
// 'display_menu', 128x64px
const unsigned char epd_bitmap_display_menu [] PROGMEM = {
  0xff, 0xff, 0xff, 0xff, 0xff, 0xff, 0xff, 0xff, 0xff, 0xff, 0xff, 0xff, 0xff, 0xff, 0xff, 0xff, 
  0x80, 0x00, 0x00, 0x00, 0x00, 0x00, 0x00, 0x00, 0x00, 0x00, 0x00, 0x00, 0x00, 0x00, 0x00, 0x01, 
  0x80, 0x00, 0x00, 0x00, 0x00, 0x00, 0x00, 0x00, 0x00, 0x00, 0x00, 0x00, 0x00, 0x00, 0x00, 0x01, 
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  0xff, 0xff, 0xff, 0xff, 0xff, 0xff, 0xff, 0xff, 0xff, 0xff, 0xff, 0xff, 0xff, 0xff, 0xff, 0xff
};
// 'menu_selector', 124x18px
const unsigned char epd_bitmap_menu_selector [] PROGMEM = {
  0x3f, 0xff, 0xff, 0xff, 0xff, 0xff, 0xff, 0xff, 0xff, 0xff, 0xff, 0xff, 0xff, 0xff, 0xff, 0xc0, 
  0x7f, 0xff, 0xff, 0xff, 0xff, 0xff, 0xff, 0xff, 0xff, 0xff, 0xff, 0xff, 0xff, 0xff, 0xff, 0xe0, 
  0xc0, 0x03, 0x80, 0x00, 0x00, 0x00, 0x00, 0x00, 0x00, 0x00, 0x00, 0x00, 0x00, 0x00, 0x00, 0x70, 
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  0x3f, 0xff, 0xff, 0xff, 0xff, 0xff, 0xff, 0xff, 0xff, 0xff, 0xff, 0xff, 0xff, 0xff, 0xff, 0xc0
};
// 'meters', 40x10px
const unsigned char epd_bitmap_meters [] PROGMEM = {
  0xc6, 0xfb, 0xf7, 0xde, 0x1f, 0xc6, 0xfb, 0xf7, 0xdf, 0x3f, 0xee, 0xc0, 0xc6, 0x1b, 0xb0, 0xfe, 
  0xc0, 0xc6, 0x19, 0xb0, 0xfe, 0xf0, 0xc7, 0x9b, 0xbe, 0xd6, 0xf0, 0xc7, 0x9f, 0x1f, 0xc6, 0xc0, 
  0xc6, 0x1e, 0x03, 0xc6, 0xc0, 0xc6, 0x1b, 0x03, 0xc6, 0xf8, 0xc7, 0xdb, 0xbf, 0xc6, 0xf8, 0xc7, 
  0xd9, 0xbe
};
// 'feet', 24x10px
const unsigned char epd_bitmap_feet [] PROGMEM = {
  0xfb, 0xef, 0xbf, 0xfb, 0xef, 0xbf, 0xc3, 0x0c, 0x0c, 0xc3, 0x0c, 0x0c, 0xf3, 0xcf, 0x0c, 0xf3, 
  0xcf, 0x0c, 0xc3, 0x0c, 0x0c, 0xc3, 0x0c, 0x0c, 0xc3, 0xef, 0x8c, 0xc3, 0xef, 0x8c
};

// Array of all bitmaps for convenience.
const int epd_bitmap_allArray_LEN = 35;
const unsigned char* epd_bitmap_allArray[epd_bitmap_allArray_LEN] = {
  epd_bitmap_number_map_0, // 0
  epd_bitmap_number_map_1, // 1
  epd_bitmap_number_map_2, // 2
  epd_bitmap_number_map_3, // 3
  epd_bitmap_number_map_4, // 4
  epd_bitmap_number_map_5, // 5 
  epd_bitmap_number_map_6, // 6
  epd_bitmap_number_map_7, // 7
  epd_bitmap_number_map_8, // 8
  epd_bitmap_number_map_9, // 9 
  epd_bitmap_display_map, // 10
  epd_bitmap_target_marker, // 11
  epd_bitmap_center_crosshair, // 12
  epd_bitmap_left_arrows, // 13
  epd_bitmap_right_arrows, // 14
  epd_bitmap_up_arrows, // 15
  epd_bitmap_down_arrows, // 16
  epd_bitmap_roll_indicator_left, // 17
  epd_bitmap_roll_indicator_right, // 18
  epd_bitmap_counterclockwise_arrows, // 19
  epd_bitmap_clockwise_arrows, // 20
  epd_bitmap_number_map_big_0, // 21
  epd_bitmap_number_map_big_1, // 22
  epd_bitmap_number_map_big_2, // 23
  epd_bitmap_number_map_big_3, // 24
  epd_bitmap_number_map_big_4, // 25
  epd_bitmap_number_map_big_5, // 26
  epd_bitmap_number_map_big_6, // 27
  epd_bitmap_number_map_big_7, // 28
  epd_bitmap_number_map_big_8, // 29
  epd_bitmap_number_map_big_9, // 30
  epd_bitmap_display_menu, // 31
  epd_bitmap_menu_selector, // 32
  epd_bitmap_meters, // 33
  epd_bitmap_feet // 34
};

void setup() {
  display.begin(SSD1306_SWITCHCAPVCC, SCREEN_I2C_ADDR);

  Serial.begin(9600);
  pinMode(BUTTON_RED_PIN, INPUT_PULLUP);
  pinMode(BUTTON_GREEN_PIN, INPUT_PULLUP);
  pinMode(BUTTON_YELLOW_PIN, INPUT_PULLUP);
  pinMode(BUTTON_BLUE_PIN, INPUT_PULLUP);

  // Clear the buffer.
  display.clearDisplay();
}

// Global Variables
int mode = 0; // 0 - menu, 1 - target
Button red_button(BUTTON_RED_PIN);
Button green_button(BUTTON_GREEN_PIN);
Button yellow_button(BUTTON_YELLOW_PIN);
Button blue_button(BUTTON_BLUE_PIN);

// Menu Variables
int selected_param = 0; // 0 - distance, 1 - speed, 2 - units
int raw_distance = 18;
int raw_speed = 75; // units / second
int units = 0; // 0 - meters, 1 - feet

// Target Variables
float pitch = -90.00;
float yaw = 360.00;
float roll = 0.00;
int battery = 99;
int arrow_counter = 0;
int target_x = 32;
int target_y = 16;
int roll_dir = 1;

void loop() {
  // Clear the buffer.
  display.clearDisplay();

  read_buttons();
  if(mode == 0){
    render_menu();
  }else{
    render_target();
  }
}

void read_buttons(){
  if(red_button.shouldTrigger()){
    mode = (mode+1) % 2;
    
  }
  if(mode == 0){
    if(blue_button.shouldTrigger()){
      if(selected_param == 0 && raw_distance > 1){
        raw_distance--;
      }else if(selected_param == 1 && raw_speed > 1){
        raw_speed--;
      }else if(selected_param == 2){
        units = (units+1) % 2;
      }
    }
    if(green_button.shouldTrigger()){
      if(selected_param == 0 && raw_distance < 998){
        raw_distance++;
      }else if(selected_param == 1 && raw_speed < 998){
        raw_speed++;
      }else if(selected_param == 2){
        units = (units+1) % 2;
      }
    }
    if(yellow_button.shouldTrigger()){
      selected_param = (selected_param+1) % 3;
    }
  }
}

void render_menu(){
  int range_1 = (int) raw_distance / 100;
  int range_2 = (int) (raw_distance/10) % 10;
  int range_3 = (int) raw_distance % 10;

  int speed_1 = (int) raw_speed / 100;
  int speed_2 = (int) (raw_speed/10) % 10;
  int speed_3 = (int) raw_speed % 10;

  // Main Background
  display.drawBitmap(0, 0, epd_bitmap_allArray[31], 128, 64, 1); 

  // Selector Bar
  display.drawBitmap(2, 2+selected_param*21, epd_bitmap_allArray[32], 124, 18, 1); 

  // Range Readout
  display.drawBitmap(102, 6, epd_bitmap_allArray[21+range_1], 6, 10, 1); 
  display.drawBitmap(109, 6, epd_bitmap_allArray[21+range_2], 6, 10, 1); 
  display.drawBitmap(116, 6, epd_bitmap_allArray[21+range_3], 6, 10, 1); 

  // Speed Readout
  display.drawBitmap(98, 26, epd_bitmap_allArray[21+speed_1], 6, 10, 1); 
  display.drawBitmap(105, 26, epd_bitmap_allArray[21+speed_2], 6, 10, 1); 
  display.drawBitmap(112, 26, epd_bitmap_allArray[21+speed_3], 6, 10, 1); 

  // Units Display
  if(units == 0){
    display.drawBitmap(59, 48, epd_bitmap_allArray[33], 40, 10, 1); 
  }else{
    display.drawBitmap(59, 48, epd_bitmap_allArray[34], 24, 10, 1); 
  }

  // Load to the display
  display.display();
}

void render_target(){
  boolean pitch_neg = pitch < 0;
  float abs_pitch = pitch_neg ? -pitch : pitch;
  int pitch_1 = (int) abs_pitch / 10;
  int pitch_2 = (int) abs_pitch % 10;
  int pitch_3 = (int) (abs_pitch*10) % 10;
  int pitch_4 = (int) (abs_pitch*100) % 10;

  int yaw_1 = (int) yaw / 100;
  int yaw_2 = (int) (yaw/10) % 10;
  int yaw_3 = (int) yaw % 10;
  int yaw_4 = (int) (yaw*10) % 10;
  int yaw_5 = (int) (yaw*100) % 10;

  int battery_1 = battery / 10;
  int battery_2 = battery % 10;

  int target_drift_x = random(5)-2;
  int target_drift_y = random(5)-2;
  if(target_x+target_drift_x > 110 || target_x+target_drift_x < 10){
    target_drift_x *= -1;
  }

  if(target_y+target_drift_y > 63 || target_y+target_drift_y < 1){
    target_drift_y *= -1;
  }

  target_x += target_drift_x;
  target_y += target_drift_y;

  boolean left_arrows = arrow_counter%100 >= 0 && arrow_counter%100 < 40;
  boolean right_arrows = arrow_counter%100 >= 20 && arrow_counter%100 < 60;
  boolean up_arrows = arrow_counter%100 >= 40 && arrow_counter%100 < 80;
  boolean down_arrows = arrow_counter%100 >= 60 && arrow_counter%100 < 100;

  int crosshair_x = 59;
  int crosshair_y = 28;

  // Main Background
  display.drawBitmap(0, 0, epd_bitmap_allArray[10], 128, 64, 1); 

  // Pitch Indicator
  display.drawBitmap(113, 26, epd_bitmap_allArray[pitch_1], 5, 3, 1);
  display.drawBitmap(113, 30, epd_bitmap_allArray[pitch_2], 5, 3, 1);
  display.drawBitmap(113, 36, epd_bitmap_allArray[pitch_3], 5, 3, 1);
  display.drawBitmap(113, 40, epd_bitmap_allArray[pitch_4], 5, 3, 1);
  // Pitch Sign
  if(!pitch_neg){
    display.drawPixel(114,23,1);
    display.drawPixel(116,23,1);
  }
  // Yaw Indicator
  display.drawBitmap(2, 22, epd_bitmap_allArray[yaw_1], 5, 3, 1);
  display.drawBitmap(2, 26, epd_bitmap_allArray[yaw_2], 5, 3, 1);
  display.drawBitmap(2, 30, epd_bitmap_allArray[yaw_3], 5, 3, 1);
  display.drawBitmap(2, 36, epd_bitmap_allArray[yaw_4], 5, 3, 1);
  display.drawBitmap(2, 40, epd_bitmap_allArray[yaw_5], 5, 3, 1);
  // Roll Indicator
  if(roll < -25){
    display.drawBitmap(51, 20, epd_bitmap_allArray[20], 25, 25, 1);
  }else if(roll > 25){
    display.drawBitmap(51, 20, epd_bitmap_allArray[19], 25, 25, 1);
  }else{
    int offset = (int) roll;
    display.drawBitmap(61-offset, 42, epd_bitmap_allArray[18], 3, 11, 1);
    display.drawBitmap(61+offset, 12, epd_bitmap_allArray[17], 3, 11, 1);
  }

  // Battery Percentage
  display.drawBitmap(121, 37, epd_bitmap_allArray[battery_1], 5, 3, 1);
  display.drawBitmap(121, 41, epd_bitmap_allArray[battery_2], 5, 3, 1);
  // Battery Fill
  for(int i = 0; i < battery_1; i++){
    display.drawPixel(122,59-i,1);
    display.drawPixel(123,59-i,1);
    display.drawPixel(124,59-i,1);
  }

  // Arrows
  if(down_arrows){  
    display.drawBitmap(3, 3, epd_bitmap_allArray[16], 12, 9, 1);
    display.drawBitmap(3, 52, epd_bitmap_allArray[16], 12, 9, 1);
  }
  if(up_arrows){  
    display.drawBitmap(105, 3, epd_bitmap_allArray[15], 12, 9, 1);
    display.drawBitmap(105, 52, epd_bitmap_allArray[15], 12, 9, 1);
  }
  if(left_arrows){  
    display.drawBitmap(54, 3, epd_bitmap_allArray[13], 19, 9, 1);
  }
  if(right_arrows){
    display.drawBitmap(54, 52, epd_bitmap_allArray[14], 19, 9, 1);
  }

  // Crosshair
  display.drawBitmap(crosshair_x,crosshair_y, epd_bitmap_allArray[12], 9, 9, 1);

  // Target Marker
  display.drawBitmap(target_x-3,target_y-3, epd_bitmap_allArray[11], 7, 7, 1);

  // Load to the display
  display.display();

  pitch += 0.01;
  if(pitch > 90.00){
    pitch = -90.00;
  }

  yaw += 0.01;
  if(yaw > 360.00){
    yaw = 0.00;
  }

  battery--;
  if(battery < 0){
    battery = 99;
  }

  arrow_counter++;
  if(arrow_counter >= 200){
    arrow_counter = 0;
  }

  roll += 0.50*roll_dir;
  if(roll < -50 || roll > 50){
    roll_dir *= -1;
  }
}
